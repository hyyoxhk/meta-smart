## conf/distro/smart.conf
```bitbake
# SPDX-License-Identifier: MIT
#
# Copyright (C) 2023 He Yong <hyyoxhk@163.com>
#

require include/smart.inc

# Distribution definition for: smart
DISTRO = "smart"
DISTRO_NAME = "smart - (A Yocto Project Based Distro)"

# DISTRO features
DISTRO_FEATURES:append = " opengl"

DISTRO_FEATURES:append = " x11 wayland vulkan"
```

## conf/layer.conf
```bitbake
# We have a conf and classes directory, add to BBPATH
BBPATH .= ":${LAYERDIR}"

# We have recipes-* directories, add to BBFILES
BBFILES += "${LAYERDIR}/recipes-*/*/*.bb \
            ${LAYERDIR}/recipes-*/*/*.bbappend"

BBFILE_COLLECTIONS += "meta-smart"
BBFILE_PATTERN_meta-smart = "^${LAYERDIR}/"
BBFILE_PRIORITY_meta-smart = "6"

LAYERDEPENDS_meta-smart = "core"
LAYERSERIES_COMPAT_meta-smart = "kirkstone"

# Set a variable to get to the top of the metadata location
SMARTBASE = '${@os.path.normpath("${LAYERDIR}")}'
```
